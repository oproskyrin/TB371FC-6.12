## mainline-port/Documentation/devicetree/bindings/leds/backlight/lenovo,tb371fc-ktz8866.yaml
```yaml
# SPDX-License-Identifier: (GPL-2.0-only OR BSD-2-Clause)
%YAML 1.2
---
$id: http://devicetree.org/schemas/leds/backlight/lenovo,tb371fc-ktz8866.yaml#
$schema: http://devicetree.org/meta-schemas/core.yaml#

title: Lenovo TB371FC synchronized dual KTZ8866 backlight

maintainers:
  - TB371FC Linux port maintainers <tb371fc-desktop@users.noreply.github.com>

description: |
  The Lenovo TB371FC uses two Kinetic Technologies KTZ8866 devices at the
  same I2C address on separate buses.  Each device drives one half of the LCD
  backlight, so both must receive identical brightness and enable writes.

  The panel pinctrl state owns the shared board-level hardware-enable and LCD
  bias GPIOs.  One controller is marked primary and exposes the single Linux
  backlight device; the board-specific driver mirrors all writes to both I2C
  clients.

allOf:
  - $ref: common.yaml#

properties:
  compatible:
    const: lenovo,tb371fc-ktz8866

  reg:
    maxItems: 1

  lenovo,primary-backlight:
    type: boolean
    description:
      Marks the controller which registers the shared Linux backlight device.

required:
  - compatible
  - reg

unevaluatedProperties: false

examples:
  - |
    i2c {
        #address-cells = <1>;
        #size-cells = <0>;

        backlight@11 {
            compatible = "lenovo,tb371fc-ktz8866";
            reg = <0x11>;
            lenovo,primary-backlight;
        };
    };
```

## mainline-port/Documentation/devicetree/bindings/media/i2c/samsung,s5k4h7.yaml
```yaml
# SPDX-License-Identifier: (GPL-2.0-only OR BSD-2-Clause)
%YAML 1.2
---
$id: http://devicetree.org/schemas/media/i2c/samsung,s5k4h7.yaml#
$schema: http://devicetree.org/meta-schemas/core.yaml#

title: Samsung S5K4H7 Image Sensor

description:
  Samsung S5K4H7 is an 8 megapixel image sensor producing RAW10 data over a
  four-lane MIPI CSI-2 D-PHY interface. The maximum active image is 3264x2448.

maintainers:
  - TB371FC Linux project <oproskyrin@users.noreply.github.com>

allOf:
  - $ref: /schemas/media/video-interface-devices.yaml#

properties:
  compatible:
    const: samsung,s5k4h7

  reg:
    maxItems: 1

  clocks:
    description: 24 MHz sensor input clock.
    maxItems: 1

  reset-gpios:
    description: Active-low sensor reset.
    maxItems: 1

  vdda-supply:
    description: Analogue voltage supply.

  vddd-supply:
    description: Digital core voltage supply.

  vddio-supply:
    description: Digital I/O voltage supply.

  port:
    $ref: /schemas/graph.yaml#/$defs/port-base
    additionalProperties: false

    properties:
      endpoint:
        $ref: /schemas/media/video-interfaces.yaml#
        unevaluatedProperties: false

        properties:
          data-lanes:
            items:
              - const: 1
              - const: 2
              - const: 3
              - const: 4

        required:
          - link-frequencies

required:
  - compatible
  - reg
  - clocks
  - reset-gpios
  - vdda-supply
  - vddd-supply
  - vddio-supply
  - port

unevaluatedProperties: false

examples:
  - |
      #include <dt-bindings/gpio/gpio.h>

      i2c {
          #address-cells = <1>;
          #size-cells = <0>;

          camera@10 {
              compatible = "samsung,s5k4h7";
              reg = <0x10>;
              clocks = <&camera_mclk 0>;
              assigned-clocks = <&camera_mclk 0>;
              assigned-clock-rates = <24000000>;
              reset-gpios = <&gpio1 10 GPIO_ACTIVE_LOW>;
              vdda-supply = <&vreg_2p8>;
              vddd-supply = <&vreg_1p2>;
              vddio-supply = <&vreg_1p8>;

              port {
                  endpoint {
                      data-lanes = <1 2 3 4>;
                      link-frequencies = /bits/ 64 <366000000>;
                      remote-endpoint = <&mipi_csi2_ep>;
                  };
              };
          };
      };
...
```
